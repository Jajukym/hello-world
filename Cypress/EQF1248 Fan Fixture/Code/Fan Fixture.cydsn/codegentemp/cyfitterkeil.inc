;
; File Name: cyfitterkeil.inc
; 
; PSoC Creator  4.2
;
; Description:
; 
;
;-------------------------------------------------------------------------------
; Copyright (c) 2007-2018 Cypress Semiconductor.  All rights reserved.
; You may use this file only in accordance with the license, terms, conditions, 
; disclaimers, and limitations in the end user license agreement accompanying 
; the software package with which this file was provided.
;-------------------------------------------------------------------------------

#ifndef INCLUDED_CYFITTERKEIL_INC
#define INCLUDED_CYFITTERKEIL_INC
$INCLUDE (cydevicekeil.inc)
$INCLUDE (cydevicekeil_trm.inc)

; pinUp
pinUp__0__INTTYPE EQU CYREG_PICU0_INTTYPE5
pinUp__0__MASK EQU 0x20
pinUp__0__PC EQU CYREG_PRT0_PC5
pinUp__0__PORT EQU 0
pinUp__0__SHIFT EQU 5
pinUp__AG EQU CYREG_PRT0_AG
pinUp__AMUX EQU CYREG_PRT0_AMUX
pinUp__BIE EQU CYREG_PRT0_BIE
pinUp__BIT_MASK EQU CYREG_PRT0_BIT_MASK
pinUp__BYP EQU CYREG_PRT0_BYP
pinUp__CTL EQU CYREG_PRT0_CTL
pinUp__DM0 EQU CYREG_PRT0_DM0
pinUp__DM1 EQU CYREG_PRT0_DM1
pinUp__DM2 EQU CYREG_PRT0_DM2
pinUp__DR EQU CYREG_PRT0_DR
pinUp__INP_DIS EQU CYREG_PRT0_INP_DIS
pinUp__INTTYPE_BASE EQU CYDEV_PICU_INTTYPE_PICU0_BASE
pinUp__LCD_COM_SEG EQU CYREG_PRT0_LCD_COM_SEG
pinUp__LCD_EN EQU CYREG_PRT0_LCD_EN
pinUp__MASK EQU 0x20
pinUp__PORT EQU 0
pinUp__PRT EQU CYREG_PRT0_PRT
pinUp__PRTDSI__CAPS_SEL EQU CYREG_PRT0_CAPS_SEL
pinUp__PRTDSI__DBL_SYNC_IN EQU CYREG_PRT0_DBL_SYNC_IN
pinUp__PRTDSI__OE_SEL0 EQU CYREG_PRT0_OE_SEL0
pinUp__PRTDSI__OE_SEL1 EQU CYREG_PRT0_OE_SEL1
pinUp__PRTDSI__OUT_SEL0 EQU CYREG_PRT0_OUT_SEL0
pinUp__PRTDSI__OUT_SEL1 EQU CYREG_PRT0_OUT_SEL1
pinUp__PRTDSI__SYNC_OUT EQU CYREG_PRT0_SYNC_OUT
pinUp__PS EQU CYREG_PRT0_PS
pinUp__SHIFT EQU 5
pinUp__SLW EQU CYREG_PRT0_SLW

; clkPWM
clkPWM__CFG0 EQU CYREG_CLKDIST_DCFG2_CFG0
clkPWM__CFG1 EQU CYREG_CLKDIST_DCFG2_CFG1
clkPWM__CFG2 EQU CYREG_CLKDIST_DCFG2_CFG2
clkPWM__CFG2_SRC_SEL_MASK EQU 0x07
clkPWM__INDEX EQU 0x02
clkPWM__PM_ACT_CFG EQU CYREG_PM_ACT_CFG2
clkPWM__PM_ACT_MSK EQU 0x04
clkPWM__PM_STBY_CFG EQU CYREG_PM_STBY_CFG2
clkPWM__PM_STBY_MSK EQU 0x04

; pinPWM
pinPWM__0__INTTYPE EQU CYREG_PICU12_INTTYPE7
pinPWM__0__MASK EQU 0x80
pinPWM__0__PC EQU CYREG_PRT12_PC7
pinPWM__0__PORT EQU 12
pinPWM__0__SHIFT EQU 7
pinPWM__AG EQU CYREG_PRT12_AG
pinPWM__BIE EQU CYREG_PRT12_BIE
pinPWM__BIT_MASK EQU CYREG_PRT12_BIT_MASK
pinPWM__BYP EQU CYREG_PRT12_BYP
pinPWM__DM0 EQU CYREG_PRT12_DM0
pinPWM__DM1 EQU CYREG_PRT12_DM1
pinPWM__DM2 EQU CYREG_PRT12_DM2
pinPWM__DR EQU CYREG_PRT12_DR
pinPWM__INP_DIS EQU CYREG_PRT12_INP_DIS
pinPWM__INTTYPE_BASE EQU CYDEV_PICU_INTTYPE_PICU12_BASE
pinPWM__MASK EQU 0x80
pinPWM__PORT EQU 12
pinPWM__PRT EQU CYREG_PRT12_PRT
pinPWM__PRTDSI__DBL_SYNC_IN EQU CYREG_PRT12_DBL_SYNC_IN
pinPWM__PRTDSI__OE_SEL0 EQU CYREG_PRT12_OE_SEL0
pinPWM__PRTDSI__OE_SEL1 EQU CYREG_PRT12_OE_SEL1
pinPWM__PRTDSI__OUT_SEL0 EQU CYREG_PRT12_OUT_SEL0
pinPWM__PRTDSI__OUT_SEL1 EQU CYREG_PRT12_OUT_SEL1
pinPWM__PRTDSI__SYNC_OUT EQU CYREG_PRT12_SYNC_OUT
pinPWM__PS EQU CYREG_PRT12_PS
pinPWM__SHIFT EQU 7
pinPWM__SIO_CFG EQU CYREG_PRT12_SIO_CFG
pinPWM__SIO_DIFF EQU CYREG_PRT12_SIO_DIFF
pinPWM__SIO_HYST_EN EQU CYREG_PRT12_SIO_HYST_EN
pinPWM__SIO_REG_HIFREQ EQU CYREG_PRT12_SIO_REG_HIFREQ
pinPWM__SLW EQU CYREG_PRT12_SLW

; pwmFan
pwmFan_PWMUDB_genblk1_ctrlreg__16BIT_CONTROL_AUX_CTL_REG EQU CYREG_B1_UDB07_08_ACTL
pwmFan_PWMUDB_genblk1_ctrlreg__16BIT_CONTROL_CONTROL_REG EQU CYREG_B1_UDB07_08_CTL
pwmFan_PWMUDB_genblk1_ctrlreg__16BIT_CONTROL_COUNT_REG EQU CYREG_B1_UDB07_08_CTL
pwmFan_PWMUDB_genblk1_ctrlreg__16BIT_COUNT_CONTROL_REG EQU CYREG_B1_UDB07_08_CTL
pwmFan_PWMUDB_genblk1_ctrlreg__16BIT_COUNT_COUNT_REG EQU CYREG_B1_UDB07_08_CTL
pwmFan_PWMUDB_genblk1_ctrlreg__16BIT_MASK_MASK_REG EQU CYREG_B1_UDB07_08_MSK
pwmFan_PWMUDB_genblk1_ctrlreg__16BIT_MASK_PERIOD_REG EQU CYREG_B1_UDB07_08_MSK
pwmFan_PWMUDB_genblk1_ctrlreg__16BIT_PERIOD_MASK_REG EQU CYREG_B1_UDB07_08_MSK
pwmFan_PWMUDB_genblk1_ctrlreg__16BIT_PERIOD_PERIOD_REG EQU CYREG_B1_UDB07_08_MSK
pwmFan_PWMUDB_genblk1_ctrlreg__7__MASK EQU 0x80
pwmFan_PWMUDB_genblk1_ctrlreg__7__POS EQU 7
pwmFan_PWMUDB_genblk1_ctrlreg__CONTROL_AUX_CTL_REG EQU CYREG_B1_UDB07_ACTL
pwmFan_PWMUDB_genblk1_ctrlreg__CONTROL_REG EQU CYREG_B1_UDB07_CTL
pwmFan_PWMUDB_genblk1_ctrlreg__CONTROL_ST_REG EQU CYREG_B1_UDB07_ST_CTL
pwmFan_PWMUDB_genblk1_ctrlreg__COUNT_REG EQU CYREG_B1_UDB07_CTL
pwmFan_PWMUDB_genblk1_ctrlreg__COUNT_ST_REG EQU CYREG_B1_UDB07_ST_CTL
pwmFan_PWMUDB_genblk1_ctrlreg__MASK EQU 0x80
pwmFan_PWMUDB_genblk1_ctrlreg__MASK_CTL_AUX_CTL_REG EQU CYREG_B1_UDB07_MSK_ACTL
pwmFan_PWMUDB_genblk1_ctrlreg__PER_CTL_AUX_CTL_REG EQU CYREG_B1_UDB07_MSK_ACTL
pwmFan_PWMUDB_genblk1_ctrlreg__PERIOD_REG EQU CYREG_B1_UDB07_MSK
pwmFan_PWMUDB_genblk8_stsreg__0__MASK EQU 0x01
pwmFan_PWMUDB_genblk8_stsreg__0__POS EQU 0
pwmFan_PWMUDB_genblk8_stsreg__16BIT_STATUS_AUX_CTL_REG EQU CYREG_B1_UDB07_08_ACTL
pwmFan_PWMUDB_genblk8_stsreg__16BIT_STATUS_REG EQU CYREG_B1_UDB07_08_ST
pwmFan_PWMUDB_genblk8_stsreg__2__MASK EQU 0x04
pwmFan_PWMUDB_genblk8_stsreg__2__POS EQU 2
pwmFan_PWMUDB_genblk8_stsreg__3__MASK EQU 0x08
pwmFan_PWMUDB_genblk8_stsreg__3__POS EQU 3
pwmFan_PWMUDB_genblk8_stsreg__MASK EQU 0x0D
pwmFan_PWMUDB_genblk8_stsreg__MASK_REG EQU CYREG_B1_UDB07_MSK
pwmFan_PWMUDB_genblk8_stsreg__MASK_ST_AUX_CTL_REG EQU CYREG_B1_UDB07_MSK_ACTL
pwmFan_PWMUDB_genblk8_stsreg__PER_ST_AUX_CTL_REG EQU CYREG_B1_UDB07_MSK_ACTL
pwmFan_PWMUDB_genblk8_stsreg__STATUS_AUX_CTL_REG EQU CYREG_B1_UDB07_ACTL
pwmFan_PWMUDB_genblk8_stsreg__STATUS_CNT_REG EQU CYREG_B1_UDB07_ST_CTL
pwmFan_PWMUDB_genblk8_stsreg__STATUS_CONTROL_REG EQU CYREG_B1_UDB07_ST_CTL
pwmFan_PWMUDB_genblk8_stsreg__STATUS_REG EQU CYREG_B1_UDB07_ST
pwmFan_PWMUDB_sP8_pwmdp_u0__16BIT_A0_REG EQU CYREG_B1_UDB07_08_A0
pwmFan_PWMUDB_sP8_pwmdp_u0__16BIT_A1_REG EQU CYREG_B1_UDB07_08_A1
pwmFan_PWMUDB_sP8_pwmdp_u0__16BIT_D0_REG EQU CYREG_B1_UDB07_08_D0
pwmFan_PWMUDB_sP8_pwmdp_u0__16BIT_D1_REG EQU CYREG_B1_UDB07_08_D1
pwmFan_PWMUDB_sP8_pwmdp_u0__16BIT_DP_AUX_CTL_REG EQU CYREG_B1_UDB07_08_ACTL
pwmFan_PWMUDB_sP8_pwmdp_u0__16BIT_F0_REG EQU CYREG_B1_UDB07_08_F0
pwmFan_PWMUDB_sP8_pwmdp_u0__16BIT_F1_REG EQU CYREG_B1_UDB07_08_F1
pwmFan_PWMUDB_sP8_pwmdp_u0__A0_A1_REG EQU CYREG_B1_UDB07_A0_A1
pwmFan_PWMUDB_sP8_pwmdp_u0__A0_REG EQU CYREG_B1_UDB07_A0
pwmFan_PWMUDB_sP8_pwmdp_u0__A1_REG EQU CYREG_B1_UDB07_A1
pwmFan_PWMUDB_sP8_pwmdp_u0__D0_D1_REG EQU CYREG_B1_UDB07_D0_D1
pwmFan_PWMUDB_sP8_pwmdp_u0__D0_REG EQU CYREG_B1_UDB07_D0
pwmFan_PWMUDB_sP8_pwmdp_u0__D1_REG EQU CYREG_B1_UDB07_D1
pwmFan_PWMUDB_sP8_pwmdp_u0__DP_AUX_CTL_REG EQU CYREG_B1_UDB07_ACTL
pwmFan_PWMUDB_sP8_pwmdp_u0__F0_F1_REG EQU CYREG_B1_UDB07_F0_F1
pwmFan_PWMUDB_sP8_pwmdp_u0__F0_REG EQU CYREG_B1_UDB07_F0
pwmFan_PWMUDB_sP8_pwmdp_u0__F1_REG EQU CYREG_B1_UDB07_F1
pwmFan_PWMUDB_sP8_pwmdp_u0__MSK_DP_AUX_CTL_REG EQU CYREG_B1_UDB07_MSK_ACTL
pwmFan_PWMUDB_sP8_pwmdp_u0__PER_DP_AUX_CTL_REG EQU CYREG_B1_UDB07_MSK_ACTL

; adcVFan
adcVFan_DEC__COHER EQU CYREG_DEC_COHER
adcVFan_DEC__CR EQU CYREG_DEC_CR
adcVFan_DEC__DR1 EQU CYREG_DEC_DR1
adcVFan_DEC__DR2 EQU CYREG_DEC_DR2
adcVFan_DEC__DR2H EQU CYREG_DEC_DR2H
adcVFan_DEC__GCOR EQU CYREG_DEC_GCOR
adcVFan_DEC__GCORH EQU CYREG_DEC_GCORH
adcVFan_DEC__GVAL EQU CYREG_DEC_GVAL
adcVFan_DEC__OCOR EQU CYREG_DEC_OCOR
adcVFan_DEC__OCORH EQU CYREG_DEC_OCORH
adcVFan_DEC__OCORM EQU CYREG_DEC_OCORM
adcVFan_DEC__OUTSAMP EQU CYREG_DEC_OUTSAMP
adcVFan_DEC__OUTSAMPH EQU CYREG_DEC_OUTSAMPH
adcVFan_DEC__OUTSAMPM EQU CYREG_DEC_OUTSAMPM
adcVFan_DEC__OUTSAMPS EQU CYREG_DEC_OUTSAMPS
adcVFan_DEC__PM_ACT_CFG EQU CYREG_PM_ACT_CFG10
adcVFan_DEC__PM_ACT_MSK EQU 0x01
adcVFan_DEC__PM_STBY_CFG EQU CYREG_PM_STBY_CFG10
adcVFan_DEC__PM_STBY_MSK EQU 0x01
adcVFan_DEC__SHIFT1 EQU CYREG_DEC_SHIFT1
adcVFan_DEC__SHIFT2 EQU CYREG_DEC_SHIFT2
adcVFan_DEC__SR EQU CYREG_DEC_SR
adcVFan_DEC__TRIM__M1 EQU CYREG_FLSHID_CUST_TABLES_DEC_M1
adcVFan_DEC__TRIM__M2 EQU CYREG_FLSHID_CUST_TABLES_DEC_M2
adcVFan_DEC__TRIM__M3 EQU CYREG_FLSHID_CUST_TABLES_DEC_M3
adcVFan_DEC__TRIM__M4 EQU CYREG_FLSHID_CUST_TABLES_DEC_M4
adcVFan_DEC__TRIM__M5 EQU CYREG_FLSHID_CUST_TABLES_DEC_M5
adcVFan_DEC__TRIM__M6 EQU CYREG_FLSHID_CUST_TABLES_DEC_M6
adcVFan_DEC__TRIM__M7 EQU CYREG_FLSHID_CUST_TABLES_DEC_M7
adcVFan_DEC__TRIM__M8 EQU CYREG_FLSHID_CUST_TABLES_DEC_M8
adcVFan_DSM__BUF0 EQU CYREG_DSM0_BUF0
adcVFan_DSM__BUF1 EQU CYREG_DSM0_BUF1
adcVFan_DSM__BUF2 EQU CYREG_DSM0_BUF2
adcVFan_DSM__BUF3 EQU CYREG_DSM0_BUF3
adcVFan_DSM__CLK EQU CYREG_DSM0_CLK
adcVFan_DSM__CR0 EQU CYREG_DSM0_CR0
adcVFan_DSM__CR1 EQU CYREG_DSM0_CR1
adcVFan_DSM__CR10 EQU CYREG_DSM0_CR10
adcVFan_DSM__CR11 EQU CYREG_DSM0_CR11
adcVFan_DSM__CR12 EQU CYREG_DSM0_CR12
adcVFan_DSM__CR13 EQU CYREG_DSM0_CR13
adcVFan_DSM__CR14 EQU CYREG_DSM0_CR14
adcVFan_DSM__CR15 EQU CYREG_DSM0_CR15
adcVFan_DSM__CR16 EQU CYREG_DSM0_CR16
adcVFan_DSM__CR17 EQU CYREG_DSM0_CR17
adcVFan_DSM__CR2 EQU CYREG_DSM0_CR2
adcVFan_DSM__CR3 EQU CYREG_DSM0_CR3
adcVFan_DSM__CR4 EQU CYREG_DSM0_CR4
adcVFan_DSM__CR5 EQU CYREG_DSM0_CR5
adcVFan_DSM__CR6 EQU CYREG_DSM0_CR6
adcVFan_DSM__CR7 EQU CYREG_DSM0_CR7
adcVFan_DSM__CR8 EQU CYREG_DSM0_CR8
adcVFan_DSM__CR9 EQU CYREG_DSM0_CR9
adcVFan_DSM__DEM0 EQU CYREG_DSM0_DEM0
adcVFan_DSM__DEM1 EQU CYREG_DSM0_DEM1
adcVFan_DSM__MISC EQU CYREG_DSM0_MISC
adcVFan_DSM__OUT0 EQU CYREG_DSM0_OUT0
adcVFan_DSM__OUT1 EQU CYREG_DSM0_OUT1
adcVFan_DSM__REF0 EQU CYREG_DSM0_REF0
adcVFan_DSM__REF1 EQU CYREG_DSM0_REF1
adcVFan_DSM__REF2 EQU CYREG_DSM0_REF2
adcVFan_DSM__REF3 EQU CYREG_DSM0_REF3
adcVFan_DSM__RSVD1 EQU CYREG_DSM0_RSVD1
adcVFan_DSM__SW0 EQU CYREG_DSM0_SW0
adcVFan_DSM__SW2 EQU CYREG_DSM0_SW2
adcVFan_DSM__SW3 EQU CYREG_DSM0_SW3
adcVFan_DSM__SW4 EQU CYREG_DSM0_SW4
adcVFan_DSM__SW6 EQU CYREG_DSM0_SW6
adcVFan_DSM__TR0 EQU CYREG_NPUMP_DSM_TR0
adcVFan_DSM__TST0 EQU CYREG_DSM0_TST0
adcVFan_DSM__TST1 EQU CYREG_DSM0_TST1
adcVFan_Ext_CP_Clk__CFG0 EQU CYREG_CLKDIST_DCFG0_CFG0
adcVFan_Ext_CP_Clk__CFG1 EQU CYREG_CLKDIST_DCFG0_CFG1
adcVFan_Ext_CP_Clk__CFG2 EQU CYREG_CLKDIST_DCFG0_CFG2
adcVFan_Ext_CP_Clk__CFG2_SRC_SEL_MASK EQU 0x07
adcVFan_Ext_CP_Clk__INDEX EQU 0x00
adcVFan_Ext_CP_Clk__PM_ACT_CFG EQU CYREG_PM_ACT_CFG2
adcVFan_Ext_CP_Clk__PM_ACT_MSK EQU 0x01
adcVFan_Ext_CP_Clk__PM_STBY_CFG EQU CYREG_PM_STBY_CFG2
adcVFan_Ext_CP_Clk__PM_STBY_MSK EQU 0x01
adcVFan_IRQ__ES2_PATCH EQU 0
adcVFan_IRQ__INTC_CLR_EN_REG EQU CYREG_INTC_CLR_EN3
adcVFan_IRQ__INTC_CLR_PD_REG EQU CYREG_INTC_CLR_PD3
adcVFan_IRQ__INTC_MASK EQU 0x20
adcVFan_IRQ__INTC_NUMBER EQU 29
adcVFan_IRQ__INTC_PRIOR_NUM EQU 7
adcVFan_IRQ__INTC_PRIOR_REG EQU CYREG_INTC_PRIOR29
adcVFan_IRQ__INTC_SET_EN_REG EQU CYREG_INTC_SET_EN3
adcVFan_IRQ__INTC_SET_PD_REG EQU CYREG_INTC_SET_PD3
adcVFan_IRQ__INTC_VECT EQU (CYREG_INTC_VECT_MBASE+0x3A)
adcVFan_theACLK__CFG0 EQU CYREG_CLKDIST_ACFG0_CFG0
adcVFan_theACLK__CFG1 EQU CYREG_CLKDIST_ACFG0_CFG1
adcVFan_theACLK__CFG2 EQU CYREG_CLKDIST_ACFG0_CFG2
adcVFan_theACLK__CFG2_SRC_SEL_MASK EQU 0x07
adcVFan_theACLK__CFG3 EQU CYREG_CLKDIST_ACFG0_CFG3
adcVFan_theACLK__CFG3_PHASE_DLY_MASK EQU 0x0F
adcVFan_theACLK__INDEX EQU 0x00
adcVFan_theACLK__PM_ACT_CFG EQU CYREG_PM_ACT_CFG1
adcVFan_theACLK__PM_ACT_MSK EQU 0x01
adcVFan_theACLK__PM_STBY_CFG EQU CYREG_PM_STBY_CFG1
adcVFan_theACLK__PM_STBY_MSK EQU 0x01

; clkPWM2
clkPWM2__CFG0 EQU CYREG_CLKDIST_DCFG1_CFG0
clkPWM2__CFG1 EQU CYREG_CLKDIST_DCFG1_CFG1
clkPWM2__CFG2 EQU CYREG_CLKDIST_DCFG1_CFG2
clkPWM2__CFG2_SRC_SEL_MASK EQU 0x07
clkPWM2__INDEX EQU 0x01
clkPWM2__PM_ACT_CFG EQU CYREG_PM_ACT_CFG2
clkPWM2__PM_ACT_MSK EQU 0x02
clkPWM2__PM_STBY_CFG EQU CYREG_PM_STBY_CFG2
clkPWM2__PM_STBY_MSK EQU 0x02

; pinDown
pinDown__0__INTTYPE EQU CYREG_PICU0_INTTYPE6
pinDown__0__MASK EQU 0x40
pinDown__0__PC EQU CYREG_PRT0_PC6
pinDown__0__PORT EQU 0
pinDown__0__SHIFT EQU 6
pinDown__AG EQU CYREG_PRT0_AG
pinDown__AMUX EQU CYREG_PRT0_AMUX
pinDown__BIE EQU CYREG_PRT0_BIE
pinDown__BIT_MASK EQU CYREG_PRT0_BIT_MASK
pinDown__BYP EQU CYREG_PRT0_BYP
pinDown__CTL EQU CYREG_PRT0_CTL
pinDown__DM0 EQU CYREG_PRT0_DM0
pinDown__DM1 EQU CYREG_PRT0_DM1
pinDown__DM2 EQU CYREG_PRT0_DM2
pinDown__DR EQU CYREG_PRT0_DR
pinDown__INP_DIS EQU CYREG_PRT0_INP_DIS
pinDown__INTTYPE_BASE EQU CYDEV_PICU_INTTYPE_PICU0_BASE
pinDown__LCD_COM_SEG EQU CYREG_PRT0_LCD_COM_SEG
pinDown__LCD_EN EQU CYREG_PRT0_LCD_EN
pinDown__MASK EQU 0x40
pinDown__PORT EQU 0
pinDown__PRT EQU CYREG_PRT0_PRT
pinDown__PRTDSI__CAPS_SEL EQU CYREG_PRT0_CAPS_SEL
pinDown__PRTDSI__DBL_SYNC_IN EQU CYREG_PRT0_DBL_SYNC_IN
pinDown__PRTDSI__OE_SEL0 EQU CYREG_PRT0_OE_SEL0
pinDown__PRTDSI__OE_SEL1 EQU CYREG_PRT0_OE_SEL1
pinDown__PRTDSI__OUT_SEL0 EQU CYREG_PRT0_OUT_SEL0
pinDown__PRTDSI__OUT_SEL1 EQU CYREG_PRT0_OUT_SEL1
pinDown__PRTDSI__SYNC_OUT EQU CYREG_PRT0_SYNC_OUT
pinDown__PS EQU CYREG_PRT0_PS
pinDown__SHIFT EQU 6
pinDown__SLW EQU CYREG_PRT0_SLW

; pinMode
pinMode__0__INTTYPE EQU CYREG_PICU15_INTTYPE5
pinMode__0__MASK EQU 0x20
pinMode__0__PC EQU CYREG_IO_PC_PRT15_PC5
pinMode__0__PORT EQU 15
pinMode__0__SHIFT EQU 5
pinMode__AG EQU CYREG_PRT15_AG
pinMode__AMUX EQU CYREG_PRT15_AMUX
pinMode__BIE EQU CYREG_PRT15_BIE
pinMode__BIT_MASK EQU CYREG_PRT15_BIT_MASK
pinMode__BYP EQU CYREG_PRT15_BYP
pinMode__CTL EQU CYREG_PRT15_CTL
pinMode__DM0 EQU CYREG_PRT15_DM0
pinMode__DM1 EQU CYREG_PRT15_DM1
pinMode__DM2 EQU CYREG_PRT15_DM2
pinMode__DR EQU CYREG_PRT15_DR
pinMode__INP_DIS EQU CYREG_PRT15_INP_DIS
pinMode__INTTYPE_BASE EQU CYDEV_PICU_INTTYPE_PICU15_BASE
pinMode__LCD_COM_SEG EQU CYREG_PRT15_LCD_COM_SEG
pinMode__LCD_EN EQU CYREG_PRT15_LCD_EN
pinMode__MASK EQU 0x20
pinMode__PORT EQU 15
pinMode__PRT EQU CYREG_PRT15_PRT
pinMode__PRTDSI__CAPS_SEL EQU CYREG_PRT15_CAPS_SEL
pinMode__PRTDSI__DBL_SYNC_IN EQU CYREG_PRT15_DBL_SYNC_IN
pinMode__PRTDSI__OE_SEL0 EQU CYREG_PRT15_OE_SEL0
pinMode__PRTDSI__OE_SEL1 EQU CYREG_PRT15_OE_SEL1
pinMode__PRTDSI__OUT_SEL0 EQU CYREG_PRT15_OUT_SEL0
pinMode__PRTDSI__OUT_SEL1 EQU CYREG_PRT15_OUT_SEL1
pinMode__PRTDSI__SYNC_OUT EQU CYREG_PRT15_SYNC_OUT
pinMode__PS EQU CYREG_PRT15_PS
pinMode__SHIFT EQU 5
pinMode__SLW EQU CYREG_PRT15_SLW

; pinPWM2
pinPWM2__0__INTTYPE EQU CYREG_PICU3_INTTYPE3
pinPWM2__0__MASK EQU 0x08
pinPWM2__0__PC EQU CYREG_PRT3_PC3
pinPWM2__0__PORT EQU 3
pinPWM2__0__SHIFT EQU 3
pinPWM2__AG EQU CYREG_PRT3_AG
pinPWM2__AMUX EQU CYREG_PRT3_AMUX
pinPWM2__BIE EQU CYREG_PRT3_BIE
pinPWM2__BIT_MASK EQU CYREG_PRT3_BIT_MASK
pinPWM2__BYP EQU CYREG_PRT3_BYP
pinPWM2__CTL EQU CYREG_PRT3_CTL
pinPWM2__DM0 EQU CYREG_PRT3_DM0
pinPWM2__DM1 EQU CYREG_PRT3_DM1
pinPWM2__DM2 EQU CYREG_PRT3_DM2
pinPWM2__DR EQU CYREG_PRT3_DR
pinPWM2__INP_DIS EQU CYREG_PRT3_INP_DIS
pinPWM2__INTTYPE_BASE EQU CYDEV_PICU_INTTYPE_PICU3_BASE
pinPWM2__LCD_COM_SEG EQU CYREG_PRT3_LCD_COM_SEG
pinPWM2__LCD_EN EQU CYREG_PRT3_LCD_EN
pinPWM2__MASK EQU 0x08
pinPWM2__PORT EQU 3
pinPWM2__PRT EQU CYREG_PRT3_PRT
pinPWM2__PRTDSI__CAPS_SEL EQU CYREG_PRT3_CAPS_SEL
pinPWM2__PRTDSI__DBL_SYNC_IN EQU CYREG_PRT3_DBL_SYNC_IN
pinPWM2__PRTDSI__OE_SEL0 EQU CYREG_PRT3_OE_SEL0
pinPWM2__PRTDSI__OE_SEL1 EQU CYREG_PRT3_OE_SEL1
pinPWM2__PRTDSI__OUT_SEL0 EQU CYREG_PRT3_OUT_SEL0
pinPWM2__PRTDSI__OUT_SEL1 EQU CYREG_PRT3_OUT_SEL1
pinPWM2__PRTDSI__SYNC_OUT EQU CYREG_PRT3_SYNC_OUT
pinPWM2__PS EQU CYREG_PRT3_PS
pinPWM2__SHIFT EQU 3
pinPWM2__SLW EQU CYREG_PRT3_SLW

; pinVFan
pinVFan__0__INTTYPE EQU CYREG_PICU3_INTTYPE2
pinVFan__0__MASK EQU 0x04
pinVFan__0__PC EQU CYREG_PRT3_PC2
pinVFan__0__PORT EQU 3
pinVFan__0__SHIFT EQU 2
pinVFan__AG EQU CYREG_PRT3_AG
pinVFan__AMUX EQU CYREG_PRT3_AMUX
pinVFan__BIE EQU CYREG_PRT3_BIE
pinVFan__BIT_MASK EQU CYREG_PRT3_BIT_MASK
pinVFan__BYP EQU CYREG_PRT3_BYP
pinVFan__CTL EQU CYREG_PRT3_CTL
pinVFan__DM0 EQU CYREG_PRT3_DM0
pinVFan__DM1 EQU CYREG_PRT3_DM1
pinVFan__DM2 EQU CYREG_PRT3_DM2
pinVFan__DR EQU CYREG_PRT3_DR
pinVFan__INP_DIS EQU CYREG_PRT3_INP_DIS
pinVFan__INTTYPE_BASE EQU CYDEV_PICU_INTTYPE_PICU3_BASE
pinVFan__LCD_COM_SEG EQU CYREG_PRT3_LCD_COM_SEG
pinVFan__LCD_EN EQU CYREG_PRT3_LCD_EN
pinVFan__MASK EQU 0x04
pinVFan__PORT EQU 3
pinVFan__PRT EQU CYREG_PRT3_PRT
pinVFan__PRTDSI__CAPS_SEL EQU CYREG_PRT3_CAPS_SEL
pinVFan__PRTDSI__DBL_SYNC_IN EQU CYREG_PRT3_DBL_SYNC_IN
pinVFan__PRTDSI__OE_SEL0 EQU CYREG_PRT3_OE_SEL0
pinVFan__PRTDSI__OE_SEL1 EQU CYREG_PRT3_OE_SEL1
pinVFan__PRTDSI__OUT_SEL0 EQU CYREG_PRT3_OUT_SEL0
pinVFan__PRTDSI__OUT_SEL1 EQU CYREG_PRT3_OUT_SEL1
pinVFan__PRTDSI__SYNC_OUT EQU CYREG_PRT3_SYNC_OUT
pinVFan__PS EQU CYREG_PRT3_PS
pinVFan__SHIFT EQU 2
pinVFan__SLW EQU CYREG_PRT3_SLW

; pwmFan2
pwmFan2_PWMUDB_genblk1_ctrlreg__16BIT_CONTROL_AUX_CTL_REG EQU CYREG_B1_UDB06_07_ACTL
pwmFan2_PWMUDB_genblk1_ctrlreg__16BIT_CONTROL_CONTROL_REG EQU CYREG_B1_UDB06_07_CTL
pwmFan2_PWMUDB_genblk1_ctrlreg__16BIT_CONTROL_COUNT_REG EQU CYREG_B1_UDB06_07_CTL
pwmFan2_PWMUDB_genblk1_ctrlreg__16BIT_COUNT_CONTROL_REG EQU CYREG_B1_UDB06_07_CTL
pwmFan2_PWMUDB_genblk1_ctrlreg__16BIT_COUNT_COUNT_REG EQU CYREG_B1_UDB06_07_CTL
pwmFan2_PWMUDB_genblk1_ctrlreg__16BIT_MASK_MASK_REG EQU CYREG_B1_UDB06_07_MSK
pwmFan2_PWMUDB_genblk1_ctrlreg__16BIT_MASK_PERIOD_REG EQU CYREG_B1_UDB06_07_MSK
pwmFan2_PWMUDB_genblk1_ctrlreg__16BIT_PERIOD_MASK_REG EQU CYREG_B1_UDB06_07_MSK
pwmFan2_PWMUDB_genblk1_ctrlreg__16BIT_PERIOD_PERIOD_REG EQU CYREG_B1_UDB06_07_MSK
pwmFan2_PWMUDB_genblk1_ctrlreg__7__MASK EQU 0x80
pwmFan2_PWMUDB_genblk1_ctrlreg__7__POS EQU 7
pwmFan2_PWMUDB_genblk1_ctrlreg__CONTROL_AUX_CTL_REG EQU CYREG_B1_UDB06_ACTL
pwmFan2_PWMUDB_genblk1_ctrlreg__CONTROL_REG EQU CYREG_B1_UDB06_CTL
pwmFan2_PWMUDB_genblk1_ctrlreg__CONTROL_ST_REG EQU CYREG_B1_UDB06_ST_CTL
pwmFan2_PWMUDB_genblk1_ctrlreg__COUNT_REG EQU CYREG_B1_UDB06_CTL
pwmFan2_PWMUDB_genblk1_ctrlreg__COUNT_ST_REG EQU CYREG_B1_UDB06_ST_CTL
pwmFan2_PWMUDB_genblk1_ctrlreg__MASK EQU 0x80
pwmFan2_PWMUDB_genblk1_ctrlreg__MASK_CTL_AUX_CTL_REG EQU CYREG_B1_UDB06_MSK_ACTL
pwmFan2_PWMUDB_genblk1_ctrlreg__PER_CTL_AUX_CTL_REG EQU CYREG_B1_UDB06_MSK_ACTL
pwmFan2_PWMUDB_genblk1_ctrlreg__PERIOD_REG EQU CYREG_B1_UDB06_MSK
pwmFan2_PWMUDB_genblk8_stsreg__0__MASK EQU 0x01
pwmFan2_PWMUDB_genblk8_stsreg__0__POS EQU 0
pwmFan2_PWMUDB_genblk8_stsreg__16BIT_STATUS_AUX_CTL_REG EQU CYREG_B1_UDB06_07_ACTL
pwmFan2_PWMUDB_genblk8_stsreg__16BIT_STATUS_REG EQU CYREG_B1_UDB06_07_ST
pwmFan2_PWMUDB_genblk8_stsreg__2__MASK EQU 0x04
pwmFan2_PWMUDB_genblk8_stsreg__2__POS EQU 2
pwmFan2_PWMUDB_genblk8_stsreg__3__MASK EQU 0x08
pwmFan2_PWMUDB_genblk8_stsreg__3__POS EQU 3
pwmFan2_PWMUDB_genblk8_stsreg__MASK EQU 0x0D
pwmFan2_PWMUDB_genblk8_stsreg__MASK_REG EQU CYREG_B1_UDB06_MSK
pwmFan2_PWMUDB_genblk8_stsreg__MASK_ST_AUX_CTL_REG EQU CYREG_B1_UDB06_MSK_ACTL
pwmFan2_PWMUDB_genblk8_stsreg__PER_ST_AUX_CTL_REG EQU CYREG_B1_UDB06_MSK_ACTL
pwmFan2_PWMUDB_genblk8_stsreg__STATUS_AUX_CTL_REG EQU CYREG_B1_UDB06_ACTL
pwmFan2_PWMUDB_genblk8_stsreg__STATUS_CNT_REG EQU CYREG_B1_UDB06_ST_CTL
pwmFan2_PWMUDB_genblk8_stsreg__STATUS_CONTROL_REG EQU CYREG_B1_UDB06_ST_CTL
pwmFan2_PWMUDB_genblk8_stsreg__STATUS_REG EQU CYREG_B1_UDB06_ST
pwmFan2_PWMUDB_sP8_pwmdp_u0__16BIT_A0_REG EQU CYREG_B1_UDB06_07_A0
pwmFan2_PWMUDB_sP8_pwmdp_u0__16BIT_A1_REG EQU CYREG_B1_UDB06_07_A1
pwmFan2_PWMUDB_sP8_pwmdp_u0__16BIT_D0_REG EQU CYREG_B1_UDB06_07_D0
pwmFan2_PWMUDB_sP8_pwmdp_u0__16BIT_D1_REG EQU CYREG_B1_UDB06_07_D1
pwmFan2_PWMUDB_sP8_pwmdp_u0__16BIT_DP_AUX_CTL_REG EQU CYREG_B1_UDB06_07_ACTL
pwmFan2_PWMUDB_sP8_pwmdp_u0__16BIT_F0_REG EQU CYREG_B1_UDB06_07_F0
pwmFan2_PWMUDB_sP8_pwmdp_u0__16BIT_F1_REG EQU CYREG_B1_UDB06_07_F1
pwmFan2_PWMUDB_sP8_pwmdp_u0__A0_A1_REG EQU CYREG_B1_UDB06_A0_A1
pwmFan2_PWMUDB_sP8_pwmdp_u0__A0_REG EQU CYREG_B1_UDB06_A0
pwmFan2_PWMUDB_sP8_pwmdp_u0__A1_REG EQU CYREG_B1_UDB06_A1
pwmFan2_PWMUDB_sP8_pwmdp_u0__D0_D1_REG EQU CYREG_B1_UDB06_D0_D1
pwmFan2_PWMUDB_sP8_pwmdp_u0__D0_REG EQU CYREG_B1_UDB06_D0
pwmFan2_PWMUDB_sP8_pwmdp_u0__D1_REG EQU CYREG_B1_UDB06_D1
pwmFan2_PWMUDB_sP8_pwmdp_u0__DP_AUX_CTL_REG EQU CYREG_B1_UDB06_ACTL
pwmFan2_PWMUDB_sP8_pwmdp_u0__F0_F1_REG EQU CYREG_B1_UDB06_F0_F1
pwmFan2_PWMUDB_sP8_pwmdp_u0__F0_REG EQU CYREG_B1_UDB06_F0
pwmFan2_PWMUDB_sP8_pwmdp_u0__F1_REG EQU CYREG_B1_UDB06_F1
pwmFan2_PWMUDB_sP8_pwmdp_u0__MSK_DP_AUX_CTL_REG EQU CYREG_B1_UDB06_MSK_ACTL
pwmFan2_PWMUDB_sP8_pwmdp_u0__PER_DP_AUX_CTL_REG EQU CYREG_B1_UDB06_MSK_ACTL

; pinStart
pinStart__0__INTTYPE EQU CYREG_PICU0_INTTYPE4
pinStart__0__MASK EQU 0x10
pinStart__0__PC EQU CYREG_PRT0_PC4
pinStart__0__PORT EQU 0
pinStart__0__SHIFT EQU 4
pinStart__AG EQU CYREG_PRT0_AG
pinStart__AMUX EQU CYREG_PRT0_AMUX
pinStart__BIE EQU CYREG_PRT0_BIE
pinStart__BIT_MASK EQU CYREG_PRT0_BIT_MASK
pinStart__BYP EQU CYREG_PRT0_BYP
pinStart__CTL EQU CYREG_PRT0_CTL
pinStart__DM0 EQU CYREG_PRT0_DM0
pinStart__DM1 EQU CYREG_PRT0_DM1
pinStart__DM2 EQU CYREG_PRT0_DM2
pinStart__DR EQU CYREG_PRT0_DR
pinStart__INP_DIS EQU CYREG_PRT0_INP_DIS
pinStart__INTTYPE_BASE EQU CYDEV_PICU_INTTYPE_PICU0_BASE
pinStart__LCD_COM_SEG EQU CYREG_PRT0_LCD_COM_SEG
pinStart__LCD_EN EQU CYREG_PRT0_LCD_EN
pinStart__MASK EQU 0x10
pinStart__PORT EQU 0
pinStart__PRT EQU CYREG_PRT0_PRT
pinStart__PRTDSI__CAPS_SEL EQU CYREG_PRT0_CAPS_SEL
pinStart__PRTDSI__DBL_SYNC_IN EQU CYREG_PRT0_DBL_SYNC_IN
pinStart__PRTDSI__OE_SEL0 EQU CYREG_PRT0_OE_SEL0
pinStart__PRTDSI__OE_SEL1 EQU CYREG_PRT0_OE_SEL1
pinStart__PRTDSI__OUT_SEL0 EQU CYREG_PRT0_OUT_SEL0
pinStart__PRTDSI__OUT_SEL1 EQU CYREG_PRT0_OUT_SEL1
pinStart__PRTDSI__SYNC_OUT EQU CYREG_PRT0_SYNC_OUT
pinStart__PS EQU CYREG_PRT0_PS
pinStart__SHIFT EQU 4
pinStart__SLW EQU CYREG_PRT0_SLW

; rtcClock
rtcClock_isr__ES2_PATCH EQU 0
rtcClock_isr__INTC_CLR_EN_REG EQU CYREG_INTC_CLR_EN0
rtcClock_isr__INTC_CLR_PD_REG EQU CYREG_INTC_CLR_PD0
rtcClock_isr__INTC_MASK EQU 0x01
rtcClock_isr__INTC_NUMBER EQU 0
rtcClock_isr__INTC_PRIOR_NUM EQU 7
rtcClock_isr__INTC_PRIOR_REG EQU CYREG_INTC_PRIOR0
rtcClock_isr__INTC_SET_EN_REG EQU CYREG_INTC_SET_EN0
rtcClock_isr__INTC_SET_PD_REG EQU CYREG_INTC_SET_PD0
rtcClock_isr__INTC_VECT EQU (CYREG_INTC_VECT_MBASE+0x00)

; isrButton
isrButton__ES2_PATCH EQU 0
isrButton__INTC_CLR_EN_REG EQU CYREG_INTC_CLR_EN0
isrButton__INTC_CLR_PD_REG EQU CYREG_INTC_CLR_PD0
isrButton__INTC_MASK EQU 0x02
isrButton__INTC_NUMBER EQU 1
isrButton__INTC_PRIOR_NUM EQU 7
isrButton__INTC_PRIOR_REG EQU CYREG_INTC_PRIOR1
isrButton__INTC_SET_EN_REG EQU CYREG_INTC_SET_EN0
isrButton__INTC_SET_PD_REG EQU CYREG_INTC_SET_PD0
isrButton__INTC_VECT EQU (CYREG_INTC_VECT_MBASE+0x02)

; clkDisplay
clkDisplay__CFG0 EQU CYREG_CLKDIST_DCFG4_CFG0
clkDisplay__CFG1 EQU CYREG_CLKDIST_DCFG4_CFG1
clkDisplay__CFG2 EQU CYREG_CLKDIST_DCFG4_CFG2
clkDisplay__CFG2_SRC_SEL_MASK EQU 0x07
clkDisplay__INDEX EQU 0x04
clkDisplay__PM_ACT_CFG EQU CYREG_PM_ACT_CFG2
clkDisplay__PM_ACT_MSK EQU 0x10
clkDisplay__PM_STBY_CFG EQU CYREG_PM_STBY_CFG2
clkDisplay__PM_STBY_MSK EQU 0x10

; lcdDisplay
lcdDisplay_LCDPort__0__INTTYPE EQU CYREG_PICU2_INTTYPE0
lcdDisplay_LCDPort__0__MASK EQU 0x01
lcdDisplay_LCDPort__0__PC EQU CYREG_PRT2_PC0
lcdDisplay_LCDPort__0__PORT EQU 2
lcdDisplay_LCDPort__0__SHIFT EQU 0
lcdDisplay_LCDPort__1__INTTYPE EQU CYREG_PICU2_INTTYPE1
lcdDisplay_LCDPort__1__MASK EQU 0x02
lcdDisplay_LCDPort__1__PC EQU CYREG_PRT2_PC1
lcdDisplay_LCDPort__1__PORT EQU 2
lcdDisplay_LCDPort__1__SHIFT EQU 1
lcdDisplay_LCDPort__2__INTTYPE EQU CYREG_PICU2_INTTYPE2
lcdDisplay_LCDPort__2__MASK EQU 0x04
lcdDisplay_LCDPort__2__PC EQU CYREG_PRT2_PC2
lcdDisplay_LCDPort__2__PORT EQU 2
lcdDisplay_LCDPort__2__SHIFT EQU 2
lcdDisplay_LCDPort__3__INTTYPE EQU CYREG_PICU2_INTTYPE3
lcdDisplay_LCDPort__3__MASK EQU 0x08
lcdDisplay_LCDPort__3__PC EQU CYREG_PRT2_PC3
lcdDisplay_LCDPort__3__PORT EQU 2
lcdDisplay_LCDPort__3__SHIFT EQU 3
lcdDisplay_LCDPort__4__INTTYPE EQU CYREG_PICU2_INTTYPE4
lcdDisplay_LCDPort__4__MASK EQU 0x10
lcdDisplay_LCDPort__4__PC EQU CYREG_PRT2_PC4
lcdDisplay_LCDPort__4__PORT EQU 2
lcdDisplay_LCDPort__4__SHIFT EQU 4
lcdDisplay_LCDPort__5__INTTYPE EQU CYREG_PICU2_INTTYPE5
lcdDisplay_LCDPort__5__MASK EQU 0x20
lcdDisplay_LCDPort__5__PC EQU CYREG_PRT2_PC5
lcdDisplay_LCDPort__5__PORT EQU 2
lcdDisplay_LCDPort__5__SHIFT EQU 5
lcdDisplay_LCDPort__6__INTTYPE EQU CYREG_PICU2_INTTYPE6
lcdDisplay_LCDPort__6__MASK EQU 0x40
lcdDisplay_LCDPort__6__PC EQU CYREG_PRT2_PC6
lcdDisplay_LCDPort__6__PORT EQU 2
lcdDisplay_LCDPort__6__SHIFT EQU 6
lcdDisplay_LCDPort__AG EQU CYREG_PRT2_AG
lcdDisplay_LCDPort__AMUX EQU CYREG_PRT2_AMUX
lcdDisplay_LCDPort__BIE EQU CYREG_PRT2_BIE
lcdDisplay_LCDPort__BIT_MASK EQU CYREG_PRT2_BIT_MASK
lcdDisplay_LCDPort__BYP EQU CYREG_PRT2_BYP
lcdDisplay_LCDPort__CTL EQU CYREG_PRT2_CTL
lcdDisplay_LCDPort__DM0 EQU CYREG_PRT2_DM0
lcdDisplay_LCDPort__DM1 EQU CYREG_PRT2_DM1
lcdDisplay_LCDPort__DM2 EQU CYREG_PRT2_DM2
lcdDisplay_LCDPort__DR EQU CYREG_PRT2_DR
lcdDisplay_LCDPort__INP_DIS EQU CYREG_PRT2_INP_DIS
lcdDisplay_LCDPort__INTTYPE_BASE EQU CYDEV_PICU_INTTYPE_PICU2_BASE
lcdDisplay_LCDPort__LCD_COM_SEG EQU CYREG_PRT2_LCD_COM_SEG
lcdDisplay_LCDPort__LCD_EN EQU CYREG_PRT2_LCD_EN
lcdDisplay_LCDPort__MASK EQU 0x7F
lcdDisplay_LCDPort__PORT EQU 2
lcdDisplay_LCDPort__PRT EQU CYREG_PRT2_PRT
lcdDisplay_LCDPort__PRTDSI__CAPS_SEL EQU CYREG_PRT2_CAPS_SEL
lcdDisplay_LCDPort__PRTDSI__DBL_SYNC_IN EQU CYREG_PRT2_DBL_SYNC_IN
lcdDisplay_LCDPort__PRTDSI__OE_SEL0 EQU CYREG_PRT2_OE_SEL0
lcdDisplay_LCDPort__PRTDSI__OE_SEL1 EQU CYREG_PRT2_OE_SEL1
lcdDisplay_LCDPort__PRTDSI__OUT_SEL0 EQU CYREG_PRT2_OUT_SEL0
lcdDisplay_LCDPort__PRTDSI__OUT_SEL1 EQU CYREG_PRT2_OUT_SEL1
lcdDisplay_LCDPort__PRTDSI__SYNC_OUT EQU CYREG_PRT2_SYNC_OUT
lcdDisplay_LCDPort__PS EQU CYREG_PRT2_PS
lcdDisplay_LCDPort__SHIFT EQU 0
lcdDisplay_LCDPort__SLW EQU CYREG_PRT2_SLW

; clkDebounce
clkDebounce__CFG0 EQU CYREG_CLKDIST_DCFG3_CFG0
clkDebounce__CFG1 EQU CYREG_CLKDIST_DCFG3_CFG1
clkDebounce__CFG2 EQU CYREG_CLKDIST_DCFG3_CFG2
clkDebounce__CFG2_SRC_SEL_MASK EQU 0x07
clkDebounce__INDEX EQU 0x03
clkDebounce__PM_ACT_CFG EQU CYREG_PM_ACT_CFG2
clkDebounce__PM_ACT_MSK EQU 0x08
clkDebounce__PM_STBY_CFG EQU CYREG_PM_STBY_CFG2
clkDebounce__PM_STBY_MSK EQU 0x08

; statusButtons
statusButtons_sts_intr_sts_reg__0__MASK EQU 0x01
statusButtons_sts_intr_sts_reg__0__POS EQU 0
statusButtons_sts_intr_sts_reg__1__MASK EQU 0x02
statusButtons_sts_intr_sts_reg__1__POS EQU 1
statusButtons_sts_intr_sts_reg__16BIT_STATUS_AUX_CTL_REG EQU CYREG_B0_UDB03_04_ACTL
statusButtons_sts_intr_sts_reg__16BIT_STATUS_REG EQU CYREG_B0_UDB03_04_ST
statusButtons_sts_intr_sts_reg__2__MASK EQU 0x04
statusButtons_sts_intr_sts_reg__2__POS EQU 2
statusButtons_sts_intr_sts_reg__3__MASK EQU 0x08
statusButtons_sts_intr_sts_reg__3__POS EQU 3
statusButtons_sts_intr_sts_reg__MASK EQU 0x0F
statusButtons_sts_intr_sts_reg__MASK_REG EQU CYREG_B0_UDB03_MSK
statusButtons_sts_intr_sts_reg__STATUS_AUX_CTL_REG EQU CYREG_B0_UDB03_ACTL
statusButtons_sts_intr_sts_reg__STATUS_REG EQU CYREG_B0_UDB03_ST

; isrUpdateDisplay
isrUpdateDisplay__ES2_PATCH EQU 0
isrUpdateDisplay__INTC_CLR_EN_REG EQU CYREG_INTC_CLR_EN0
isrUpdateDisplay__INTC_CLR_PD_REG EQU CYREG_INTC_CLR_PD0
isrUpdateDisplay__INTC_MASK EQU 0x04
isrUpdateDisplay__INTC_NUMBER EQU 2
isrUpdateDisplay__INTC_PRIOR_NUM EQU 7
isrUpdateDisplay__INTC_PRIOR_REG EQU CYREG_INTC_PRIOR2
isrUpdateDisplay__INTC_SET_EN_REG EQU CYREG_INTC_SET_EN0
isrUpdateDisplay__INTC_SET_PD_REG EQU CYREG_INTC_SET_PD0
isrUpdateDisplay__INTC_VECT EQU (CYREG_INTC_VECT_MBASE+0x04)

; Miscellaneous
BCLK__BUS_CLK__HZ EQU 24000000
BCLK__BUS_CLK__KHZ EQU 24000
BCLK__BUS_CLK__MHZ EQU 24
CY_PROJECT_NAME LIT 'Fan Fixture'
CY_VERSION LIT 'PSoC Creator  4.2'
CYDEV_CHIP_DIE_LEOPARD EQU 1
CYDEV_CHIP_DIE_PSOC4A EQU 18
CYDEV_CHIP_DIE_PSOC5LP EQU 2
CYDEV_CHIP_DIE_PSOC5TM EQU 3
CYDEV_CHIP_DIE_TMA4 EQU 4
CYDEV_CHIP_DIE_UNKNOWN EQU 0
CYDEV_CHIP_FAMILY_FM0P EQU 5
CYDEV_CHIP_FAMILY_FM3 EQU 6
CYDEV_CHIP_FAMILY_FM4 EQU 7
CYDEV_CHIP_FAMILY_PSOC3 EQU 1
CYDEV_CHIP_FAMILY_PSOC4 EQU 2
CYDEV_CHIP_FAMILY_PSOC5 EQU 3
CYDEV_CHIP_FAMILY_PSOC6 EQU 4
CYDEV_CHIP_FAMILY_UNKNOWN EQU 0
CYDEV_CHIP_FAMILY_USED EQU CYDEV_CHIP_FAMILY_PSOC3
CYDEV_CHIP_JTAG_ID EQU 0x1E095069
CYDEV_CHIP_MEMBER_3A EQU 1
CYDEV_CHIP_MEMBER_4A EQU 18
CYDEV_CHIP_MEMBER_4D EQU 13
CYDEV_CHIP_MEMBER_4E EQU 6
CYDEV_CHIP_MEMBER_4F EQU 19
CYDEV_CHIP_MEMBER_4G EQU 4
CYDEV_CHIP_MEMBER_4H EQU 17
CYDEV_CHIP_MEMBER_4I EQU 23
CYDEV_CHIP_MEMBER_4J EQU 14
CYDEV_CHIP_MEMBER_4K EQU 15
CYDEV_CHIP_MEMBER_4L EQU 22
CYDEV_CHIP_MEMBER_4M EQU 21
CYDEV_CHIP_MEMBER_4N EQU 10
CYDEV_CHIP_MEMBER_4O EQU 7
CYDEV_CHIP_MEMBER_4P EQU 20
CYDEV_CHIP_MEMBER_4Q EQU 12
CYDEV_CHIP_MEMBER_4R EQU 8
CYDEV_CHIP_MEMBER_4S EQU 11
CYDEV_CHIP_MEMBER_4T EQU 9
CYDEV_CHIP_MEMBER_4U EQU 5
CYDEV_CHIP_MEMBER_4V EQU 16
CYDEV_CHIP_MEMBER_5A EQU 3
CYDEV_CHIP_MEMBER_5B EQU 2
CYDEV_CHIP_MEMBER_6A EQU 24
CYDEV_CHIP_MEMBER_FM3 EQU 28
CYDEV_CHIP_MEMBER_FM4 EQU 29
CYDEV_CHIP_MEMBER_PDL_FM0P_TYPE1 EQU 25
CYDEV_CHIP_MEMBER_PDL_FM0P_TYPE2 EQU 26
CYDEV_CHIP_MEMBER_PDL_FM0P_TYPE3 EQU 27
CYDEV_CHIP_MEMBER_UNKNOWN EQU 0
CYDEV_CHIP_MEMBER_USED EQU CYDEV_CHIP_MEMBER_3A
CYDEV_CHIP_DIE_EXPECT EQU CYDEV_CHIP_MEMBER_USED
CYDEV_CHIP_DIE_ACTUAL EQU CYDEV_CHIP_DIE_EXPECT
CYDEV_CHIP_REV_LEOPARD_ES1 EQU 0
CYDEV_CHIP_REV_LEOPARD_ES2 EQU 1
CYDEV_CHIP_REV_LEOPARD_ES3 EQU 3
CYDEV_CHIP_REV_LEOPARD_PRODUCTION EQU 3
CYDEV_CHIP_REV_PSOC4A_ES0 EQU 17
CYDEV_CHIP_REV_PSOC4A_PRODUCTION EQU 17
CYDEV_CHIP_REV_PSOC5LP_ES0 EQU 0
CYDEV_CHIP_REV_PSOC5LP_PRODUCTION EQU 0
CYDEV_CHIP_REV_PSOC5TM_ES0 EQU 0
CYDEV_CHIP_REV_PSOC5TM_ES1 EQU 1
CYDEV_CHIP_REV_PSOC5TM_PRODUCTION EQU 1
CYDEV_CHIP_REV_TMA4_ES EQU 17
CYDEV_CHIP_REV_TMA4_ES2 EQU 33
CYDEV_CHIP_REV_TMA4_PRODUCTION EQU 17
CYDEV_CHIP_REVISION_3A_ES1 EQU 0
CYDEV_CHIP_REVISION_3A_ES2 EQU 1
CYDEV_CHIP_REVISION_3A_ES3 EQU 3
CYDEV_CHIP_REVISION_3A_PRODUCTION EQU 3
CYDEV_CHIP_REVISION_4A_ES0 EQU 17
CYDEV_CHIP_REVISION_4A_PRODUCTION EQU 17
CYDEV_CHIP_REVISION_4D_PRODUCTION EQU 0
CYDEV_CHIP_REVISION_4E_CCG2_NO_USBPD EQU 0
CYDEV_CHIP_REVISION_4E_PRODUCTION EQU 0
CYDEV_CHIP_REVISION_4F_PRODUCTION EQU 0
CYDEV_CHIP_REVISION_4F_PRODUCTION_256DMA EQU 0
CYDEV_CHIP_REVISION_4F_PRODUCTION_256K EQU 0
CYDEV_CHIP_REVISION_4G_ES EQU 17
CYDEV_CHIP_REVISION_4G_ES2 EQU 33
CYDEV_CHIP_REVISION_4G_PRODUCTION EQU 17
CYDEV_CHIP_REVISION_4H_PRODUCTION EQU 0
CYDEV_CHIP_REVISION_4I_PRODUCTION EQU 0
CYDEV_CHIP_REVISION_4J_PRODUCTION EQU 0
CYDEV_CHIP_REVISION_4K_PRODUCTION EQU 0
CYDEV_CHIP_REVISION_4L_PRODUCTION EQU 0
CYDEV_CHIP_REVISION_4M_PRODUCTION EQU 0
CYDEV_CHIP_REVISION_4N_PRODUCTION EQU 0
CYDEV_CHIP_REVISION_4O_PRODUCTION EQU 0
CYDEV_CHIP_REVISION_4P_PRODUCTION EQU 0
CYDEV_CHIP_REVISION_4Q_PRODUCTION EQU 0
CYDEV_CHIP_REVISION_4R_PRODUCTION EQU 0
CYDEV_CHIP_REVISION_4S_PRODUCTION EQU 0
CYDEV_CHIP_REVISION_4T_PRODUCTION EQU 0
CYDEV_CHIP_REVISION_4U_PRODUCTION EQU 0
CYDEV_CHIP_REVISION_4V_PRODUCTION EQU 0
CYDEV_CHIP_REVISION_5A_ES0 EQU 0
CYDEV_CHIP_REVISION_5A_ES1 EQU 1
CYDEV_CHIP_REVISION_5A_PRODUCTION EQU 1
CYDEV_CHIP_REVISION_5B_ES0 EQU 0
CYDEV_CHIP_REVISION_5B_PRODUCTION EQU 0
CYDEV_CHIP_REVISION_6A_ES EQU 17
CYDEV_CHIP_REVISION_6A_NO_UDB EQU 33
CYDEV_CHIP_REVISION_6A_PRODUCTION EQU 33
CYDEV_CHIP_REVISION_FM3_PRODUCTION EQU 0
CYDEV_CHIP_REVISION_FM4_PRODUCTION EQU 0
CYDEV_CHIP_REVISION_PDL_FM0P_TYPE1_PRODUCTION EQU 0
CYDEV_CHIP_REVISION_PDL_FM0P_TYPE2_PRODUCTION EQU 0
CYDEV_CHIP_REVISION_PDL_FM0P_TYPE3_PRODUCTION EQU 0
CYDEV_CHIP_REVISION_USED EQU CYDEV_CHIP_REVISION_3A_PRODUCTION
CYDEV_CHIP_REV_EXPECT EQU CYDEV_CHIP_REVISION_USED
CYDEV_CONFIG_FASTBOOT_ENABLED EQU 1
CYDEV_CONFIG_UNUSED_IO_AllowButWarn EQU 0
CYDEV_CONFIG_UNUSED_IO EQU CYDEV_CONFIG_UNUSED_IO_AllowButWarn
CYDEV_CONFIG_UNUSED_IO_AllowWithInfo EQU 1
CYDEV_CONFIG_UNUSED_IO_Disallowed EQU 2
CYDEV_CONFIGURATION_CLEAR_SRAM EQU 1
CYDEV_CONFIGURATION_COMPRESSED EQU 1
CYDEV_CONFIGURATION_DMA EQU 0
CYDEV_CONFIGURATION_ECC EQU 1
CYDEV_CONFIGURATION_IMOENABLED EQU CYDEV_CONFIG_FASTBOOT_ENABLED
CYDEV_CONFIGURATION_MODE_COMPRESSED EQU 0
CYDEV_CONFIGURATION_MODE EQU CYDEV_CONFIGURATION_MODE_COMPRESSED
CYDEV_CONFIGURATION_MODE_DMA EQU 2
CYDEV_CONFIGURATION_MODE_UNCOMPRESSED EQU 1
CYDEV_DEBUG_ENABLE_MASK EQU 0x01
CYDEV_DEBUG_ENABLE_REGISTER EQU CYREG_MLOGIC_DEBUG
CYDEV_DEBUGGING_DPS_Disable EQU 3
CYDEV_DEBUGGING_DPS_JTAG_4 EQU 1
CYDEV_DEBUGGING_DPS_JTAG_5 EQU 0
CYDEV_DEBUGGING_DPS_SWD EQU 2
CYDEV_DEBUGGING_DPS_SWD_SWV EQU 6
CYDEV_DEBUGGING_DPS EQU CYDEV_DEBUGGING_DPS_SWD_SWV
CYDEV_DEBUGGING_ENABLE EQU 1
CYDEV_DEBUGGING_XRES EQU 0
CYDEV_DMA_CHANNELS_AVAILABLE EQU 24
CYDEV_ECC_ENABLE EQU 0
CYDEV_INSTRUCT_CACHE_ENABLED EQU 1
CYDEV_INTR_RISING EQU 0x00000006
CYDEV_IS_EXPORTING_CODE EQU 0
CYDEV_IS_IMPORTING_CODE EQU 0
CYDEV_PROJ_TYPE EQU 0
CYDEV_PROJ_TYPE_BOOTLOADER EQU 1
CYDEV_PROJ_TYPE_LAUNCHER EQU 5
CYDEV_PROJ_TYPE_LOADABLE EQU 2
CYDEV_PROJ_TYPE_LOADABLEANDBOOTLOADER EQU 4
CYDEV_PROJ_TYPE_MULTIAPPBOOTLOADER EQU 3
CYDEV_PROJ_TYPE_STANDARD EQU 0
CYDEV_PROTECTION_ENABLE EQU 0
CYDEV_VARIABLE_VDDA EQU 0
CYDEV_VDDA LIT '5.0'
CYDEV_VDDA_MV EQU 5000
CYDEV_VDDD LIT '5.0'
CYDEV_VDDD_MV EQU 5000
CYDEV_VDDIO0 LIT '5.0'
CYDEV_VDDIO0_MV EQU 5000
CYDEV_VDDIO1 LIT '5.0'
CYDEV_VDDIO1_MV EQU 5000
CYDEV_VDDIO2 LIT '5.0'
CYDEV_VDDIO2_MV EQU 5000
CYDEV_VDDIO3 LIT '5.0'
CYDEV_VDDIO3_MV EQU 5000
CYDEV_VIO0 LIT '5.0'
CYDEV_VIO0_MV EQU 5000
CYDEV_VIO1 LIT '5.0'
CYDEV_VIO1_MV EQU 5000
CYDEV_VIO2 LIT '5.0'
CYDEV_VIO2_MV EQU 5000
CYDEV_VIO3 LIT '5.0'
CYDEV_VIO3_MV EQU 5000
CYIPBLOCK_DP8051_VERSION EQU 0
CYIPBLOCK_P3_ANAIF_VERSION EQU 0
CYIPBLOCK_P3_CAPSENSE_VERSION EQU 0
CYIPBLOCK_P3_COMP_VERSION EQU 0
CYIPBLOCK_P3_DECIMATOR_VERSION EQU 0
CYIPBLOCK_P3_DMA_VERSION EQU 0
CYIPBLOCK_P3_DRQ_VERSION EQU 0
CYIPBLOCK_P3_DSM_VERSION EQU 0
CYIPBLOCK_P3_EMIF_VERSION EQU 0
CYIPBLOCK_P3_I2C_VERSION EQU 0
CYIPBLOCK_P3_LCD_VERSION EQU 0
CYIPBLOCK_P3_LPF_VERSION EQU 0
CYIPBLOCK_P3_PM_VERSION EQU 0
CYIPBLOCK_P3_TIMER_VERSION EQU 0
CYIPBLOCK_P3_VIDAC_VERSION EQU 0
CYIPBLOCK_P3_VREF_VERSION EQU 0
CYIPBLOCK_S8_GPIO_VERSION EQU 0
CYIPBLOCK_S8_IRQ_VERSION EQU 0
CYIPBLOCK_S8_SIO_VERSION EQU 0
CYIPBLOCK_S8_UDB_VERSION EQU 0
DMA_CHANNELS_USED__MASK0 EQU 0x00000000
CYDEV_BOOTLOADER_ENABLE EQU 0

#endif /* INCLUDED_CYFITTERKEIL_INC */
